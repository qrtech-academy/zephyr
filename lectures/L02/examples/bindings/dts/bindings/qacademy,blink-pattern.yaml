## lectures/L02/examples/bindings/sample.yaml
```yaml
sample:
  name: Bindings
  description: A custom devicetree binding, and a table of its nodes built at compile time.
common:
  platform_allow: native_sim/native/64
  integration_platforms:
    - native_sim/native/64
  extra_configs:
    - CONFIG_NATIVE_SIM_SLOWDOWN_TO_REAL_TIME=n
tests:
  qacademy.l02.bindings:
    harness: console
    harness_config:
      type: multi_line
      ordered: true
      regex:
        - "<inf> bindings: 2 pattern\\(s\\) enabled"
        - "<inf> bindings: strobe exists: yes, enabled: no"
        - "<inf> bindings: pattern-sos: \"SOS\" on gpio_emul pin 0, 18 steps, 3400 ms, x1"
        - "<inf> bindings: pattern-heartbeat: \"Heartbeat\" on gpio_emul pin 2, 4 steps, 1000 ms, x2"
        - "<inf> bindings: Played SOS, uptime 3580 ms"
        - "<inf> bindings: Played Heartbeat, uptime 5660 ms"
```

## lectures/L02/examples/button/sample.yaml
```yaml
sample:
  name: Button
  description: A button added by an overlay, an edge interrupt callback, and an emulated finger.
common:
  platform_allow: native_sim/native/64
  integration_platforms:
    - native_sim/native/64
  extra_configs:
    - CONFIG_NATIVE_SIM_SLOWDOWN_TO_REAL_TIME=n
tests:
  qacademy.l02.button:
    harness: console
    harness_config:
      type: multi_line
      ordered: true
      regex:
        - "<inf> button: Button is pin 1 on gpio_emul, LED is pin 0"
        - "<inf> button: Press 1 \\(thread\\): LED on"
        - "<inf> button: Press 2 \\(thread\\): LED off"
        - "<inf> button: Press 3 \\(thread\\): LED on"
```

## lectures/L05/examples/thermo/module/drivers/sensor/thermo/Kconfig
```kconfig
# SPDX-License-Identifier: MIT

config THERMO
	bool "Thermo I2C temperature sensor"
	default y
	depends on SENSOR
	depends on DT_HAS_QACADEMY_THERMO_ENABLED
	select I2C
	help
	  Driver for the Thermo I2C temperature sensor. It is on by default,
	  but only when the devicetree has a node with compatible
	  "qacademy,thermo" whose status is okay: DT_HAS_QACADEMY_THERMO_ENABLED
	  is generated from the devicetree. This is the pattern every driver in
	  Zephyr follows, and why enabling a driver usually means adding a
	  devicetree node rather than setting an option.

config EMUL_THERMO
	bool "Emulator for the Thermo I2C temperature sensor"
	default y
	depends on THERMO
	depends on EMUL
	help
	  An emulator that plays the part of the chip on an emulated I2C bus,
	  such as native_sim's i2c0. Enabled whenever emulators are (CONFIG_EMUL).
```

## lectures/L05/examples/thermo/module/dts/bindings/sensor/qacademy,thermo.yaml
```yaml
# SPDX-License-Identifier: MIT

description: |
  Thermo, a made-up I2C temperature sensor with a 12-bit reading in steps of 1/16 degree Celsius.

  The binding is the contract between the devicetree and the driver: a node with this compatible
  must sit on an I2C bus (that is what i2c-device.yaml requires, including its reg property, the
  bus address), and may set the properties below.

    &i2c0 {
            thermo: thermo@48 {
                    compatible = "qacademy,thermo";
                    reg = <0x48>;
            };
    };

compatible: "qacademy,thermo"

include: [sensor-device.yaml, i2c-device.yaml]

properties:
  conversion-timeout-ms:
    type: int
    default: 100
    description: |
      How long the driver waits for a one-shot conversion to finish before it gives up with
      -ETIMEDOUT. The part converts in about 30 ms.
```

## lectures/L05/examples/thermo/tests/testcase.yaml
```yaml
common:
  platform_allow: native_sim/native/64
  integration_platforms:
    - native_sim/native/64
  harness: ztest
  tags:
    - sensor
tests:
  qacademy.l05.thermo.driver: {}
```

## lectures/L05/exercises/test/lumo_emul/Kconfig
```kconfig
# SPDX-License-Identifier: MIT

config EMUL_LUMO
	bool "Emulator for the Lumo ambient light sensor"
	default y
	depends on I2C_EMUL
	depends on DT_HAS_QACADEMY_LUMO_ENABLED
	help
	  Plays the part of a Lumo chip for every "qacademy,lumo" node on an
	  emulated I2C bus. DT_HAS_QACADEMY_LUMO_ENABLED only exists once a
	  binding for "qacademy,lumo" does, so the emulator is only built
	  together with your binding.

config EMUL_LUMO_DAYLIGHT
	bool "Simulate a sunrise around every emulated Lumo part"
	depends on EMUL_LUMO
	help
	  Starts a thread that sets the light level of every emulated part
	  half a second before each whole second of uptime, for the first
	  seven seconds. Exercise Set 4's application is run with it.
```
