## CMakeLists.txt
```
# SPDX-License-Identifier: MIT

cmake_minimum_required(VERSION 3.20.0)
find_package(Zephyr REQUIRED HINTS $ENV{ZEPHYR_BASE})
project(sockets)

target_sources(app PRIVATE src/main.c)
target_sources_ifdef(CONFIG_APP_SELF_TEST app PRIVATE src/self_test.c)
```

## Kconfig
```
# SPDX-License-Identifier: MIT

menu "Application"

config APP_PORT
	int "TCP port the echo server listens on"
	range 1024 65535
	default 4242

config APP_SELF_TEST
	bool "Connect to the server from a second thread and check the echo"
	help
	  Starts a client thread in the same program, which connects to the server through the host's
	  loopback interface, sends a message, and checks that the same bytes come back. This is how
	  the example is tested without anything outside the program.

endmenu

source "Kconfig.zephyr"
```

## sample.yaml
```
sample:
  name: Sockets
  description: A TCP echo server, reachable from the host through native_sim's offloaded sockets.
common:
  platform_allow: native_sim/native/64
  integration_platforms:
    - native_sim/native/64
tests:
  # The server on its own waits for a client from the host forever, so it is only built.
  qacademy.l06.sockets:
    build_only: true
  # With the self-test, a client thread in the same program checks the echo.
  qacademy.l06.sockets.self_test:
    extra_args:
      - EXTRA_CONF_FILE=self_test.conf
    extra_configs:
      - CONFIG_NATIVE_SIM_SLOWDOWN_TO_REAL_TIME=n
    harness: console
    harness_config:
      type: multi_line
      ordered: true
      regex:
        - "<inf> app: Listening on TCP port 4242"
        - "<inf> app: Client connected"
        - "<inf> app: Echoed 19 bytes"
        - "<inf> self_test: Self-test passed: the server echoed \"Hello, echo server!\""
```

## prj.conf
```kconfig
# Networking with BSD-style sockets over IPv4.
CONFIG_NETWORKING=y
CONFIG_NET_IPV4=y
CONFIG_NET_IPV6=n
CONFIG_NET_SOCKETS=y

# Offload the sockets to native_sim's host: every zsock_ call becomes a call to the Linux socket
# API, so the program talks to the host's network directly. Zephyr's own IP stack is not used, and
# no TAP interface, bridge or root privileges are needed. The price is that nothing below the
# socket API is Zephyr's: this tests the application, not the network stack.
CONFIG_NET_DRIVERS=y
CONFIG_NET_SOCKETS_OFFLOAD=y
CONFIG_NET_NATIVE_OFFLOADED_SOCKETS=y
CONFIG_ETH_NATIVE_TAP=n

CONFIG_LOG=y
```

## self_test.conf
```kconfig
# Test the server from inside the program:
#
#   west build -b native_sim/native/64 lectures/L06/examples/sockets -- -DEXTRA_CONF_FILE=self_test.conf
CONFIG_APP_SELF_TEST=y
```

## src/main.c
```c
/*
 * SPDX-License-Identifier: MIT
 *
 * A TCP echo server, reachable from the host through native_sim's offloaded sockets.
 */

#include <zephyr/kernel.h>
#include <zephyr/logging/log.h>
#include <zephyr/net/socket.h>

LOG_MODULE_REGISTER(app, LOG_LEVEL_INF);

#define SERVER_STACK_SIZE 2048
#define SERVER_PRIORITY   7

/* Send all of a buffer. A stream socket may accept fewer bytes than asked, so send until done. */
static int send_all(int sock, const char *buf, size_t len)
{
	while (len > 0) {
		ssize_t sent = zsock_send(sock, buf, len, 0);

		if (sent < 0) {
			return -errno;
		}
		buf += sent;
		len -= sent;
	}
	return 0;
}

/* Echo everything a client sends until it closes the connection. */
static void serve_client(int client)
{
	char buf[128];

	for (;;) {
		/* Blocks this thread only: the other threads keep running while it waits. */
		ssize_t received = zsock_recv(client, buf, sizeof(buf), 0);

		if (received == 0) {
			return; /* The client closed the connection. */
		}
		if (received < 0) {
			LOG_ERR("recv() failed: %d", errno);
			return;
		}
		if (send_all(client, buf, received) < 0) {
			LOG_ERR("send() failed: %d", errno);
			return;
		}
		LOG_INF("Echoed %zd bytes", received);
	}
}

static void server(void *p1, void *p2, void *p3)
{
	ARG_UNUSED(p1);
	ARG_UNUSED(p2);
	ARG_UNUSED(p3);

	struct net_sockaddr_in addr = {
		.sin_family = NET_AF_INET,
		.sin_port = net_htons(CONFIG_APP_PORT),
		.sin_addr.s_addr = net_htonl(NET_INADDR_ANY),
	};
	int one = 1;
	int listener = zsock_socket(NET_AF_INET, NET_SOCK_STREAM, NET_IPPROTO_TCP);

	if (listener < 0) {
		LOG_ERR("socket() failed: %d", errno);
		return;
	}

	/* Allow a restarted program to listen on the port again at once, as on any Linux server. */
	zsock_setsockopt(listener, ZSOCK_SOL_SOCKET, ZSOCK_SO_REUSEADDR, &one, sizeof(one));

	if ((zsock_bind(listener, (struct net_sockaddr *)&addr, sizeof(addr)) < 0) ||
	    (zsock_listen(listener, 1) < 0)) {
		LOG_ERR("Cannot listen on port %d: %d", CONFIG_APP_PORT, errno);
		zsock_close(listener);
		return;
	}
	LOG_INF("Listening on TCP port %d", CONFIG_APP_PORT);

	/* One client at a time: enough for an echo server, and it keeps the example to one thread.
	 */
	for (;;) {
		int client = zsock_accept(listener, NULL, NULL);

		if (client < 0) {
			LOG_ERR("accept() failed: %d", errno);
			continue;
		}
		LOG_INF("Client connected");

		/*
		 * Workaround for native_sim in Zephyr 4.4: the offloaded-sockets driver does not
		 * initialize the timeouts of a socket returned by accept(). A zero timeout there
		 * makes a blocking recv() call straight into the host's recv(), which blocks the
		 * whole process, simulated time included, instead of just this thread. Setting both
		 * timeouts explicitly to zero, which means "wait forever", initializes them. On a
		 * board, and with Zephyr's own IP stack, this is harmless and changes nothing.
		 */
		struct zsock_timeval forever = {0};

		zsock_setsockopt(client, ZSOCK_SOL_SOCKET, ZSOCK_SO_RCVTIMEO, &forever,
				 sizeof(forever));
		zsock_setsockopt(client, ZSOCK_SOL_SOCKET, ZSOCK_SO_SNDTIMEO, &forever,
				 sizeof(forever));

		serve_client(client);
		zsock_close(client);
		LOG_INF("Client disconnected");
	}
}

K_THREAD_DEFINE(server_thread, SERVER_STACK_SIZE, server, NULL, NULL, NULL, SERVER_PRIORITY, 0, 0);
```

## src/self_test.c
```c
/*
 * SPDX-License-Identifier: MIT
 *
 * A client for the echo server in main.c, run in the same program when CONFIG_APP_SELF_TEST=y.
 */

#include <string.h>

#include <zephyr/kernel.h>
#include <zephyr/logging/log.h>
#include <zephyr/net/socket.h>

LOG_MODULE_REGISTER(self_test, LOG_LEVEL_INF);

#define CLIENT_STACK_SIZE 2048
#define CLIENT_PRIORITY   8
#define CLIENT_DELAY_MS   100

static const char message[] = "Hello, echo server!";

static void client(void *p1, void *p2, void *p3)
{
	ARG_UNUSED(p1);
	ARG_UNUSED(p2);
	ARG_UNUSED(p3);

	struct net_sockaddr_in addr = {
		.sin_family = NET_AF_INET,
		.sin_port = net_htons(CONFIG_APP_PORT),
		.sin_addr = NET_INADDR_LOOPBACK_INIT,
	};
	char reply[sizeof(message)] = {0};
	size_t received = 0;
	int sock = zsock_socket(NET_AF_INET, NET_SOCK_STREAM, NET_IPPROTO_TCP);

	if ((sock < 0) || (zsock_connect(sock, (struct net_sockaddr *)&addr, sizeof(addr)) < 0)) {
		LOG_ERR("Cannot connect to port %d: %d", CONFIG_APP_PORT, errno);
		goto out;
	}

	if (zsock_send(sock, message, strlen(message), 0) != (ssize_t)strlen(message)) {
		LOG_ERR("send() failed: %d", errno);
		goto out;
	}

	/* The echo may arrive in pieces; a stream socket keeps no message boundaries. */
	while (received < strlen(message)) {
		ssize_t n = zsock_recv(sock, reply + received, strlen(message) - received, 0);

		if (n <= 0) {
			LOG_ERR("recv() failed after %zu bytes: %d", received, errno);
			goto out;
		}
		received += n;
	}

	if (memcmp(reply, message, strlen(message)) == 0) {
		LOG_INF("Self-test passed: the server echoed \"%s\"", reply);
	} else {
		LOG_ERR("Self-test failed: sent \"%s\", got \"%s\"", message, reply);
	}

out:
	if (sock >= 0) {
		zsock_close(sock);
	}
}

/* Start after a delay, so that the server is listening by the time the client connects. */
K_THREAD_DEFINE(client_thread, CLIENT_STACK_SIZE, client, NULL, NULL, NULL, CLIENT_PRIORITY, 0,
		CLIENT_DELAY_MS);
```
