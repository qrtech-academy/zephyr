## CMakeLists.txt
```
# SPDX-License-Identifier: MIT

cmake_minimum_required(VERSION 3.20.0)
find_package(Zephyr REQUIRED HINTS $ENV{ZEPHYR_BASE})
project(settings)

target_sources(app PRIVATE src/main.c)
```

## sample.yaml
```
sample:
  name: Settings
  description: A boot counter kept by the settings subsystem on the simulated flash.
common:
  platform_allow: native_sim/native/64
  integration_platforms:
    - native_sim/native/64
  extra_configs:
    - CONFIG_NATIVE_SIM_SLOWDOWN_TO_REAL_TIME=n
tests:
  qacademy.l06.settings:
    harness: console
    harness_config:
      type: multi_line
      ordered: true
      regex:
        # Any count: a second Twister run in the same output directory finds the first run's flash.
        - "<inf> app: Boot count: [0-9]+"
```

## prj.conf
```kconfig
# The settings subsystem stores key-value pairs through a storage back-end. With ZMS (Zephyr
# Memory Storage) enabled, it picks ZMS, which writes to the flash partition labelled
# storage_partition in the board's devicetree. On native_sim that flash is simulated, in a file.
CONFIG_FLASH=y
CONFIG_FLASH_MAP=y
CONFIG_ZMS=y
CONFIG_SETTINGS=y

CONFIG_LOG=y

# ZMS logs its mount at level INF; only warnings and errors are of interest here.
CONFIG_ZMS_LOG_LEVEL_WRN=y
```

## src/main.c
```c
/*
 * SPDX-License-Identifier: MIT
 *
 * A boot counter that survives a restart, kept by the settings subsystem on the simulated flash.
 */

#include <zephyr/kernel.h>
#include <zephyr/logging/log.h>
#include <zephyr/settings/settings.h>

LOG_MODULE_REGISTER(app, LOG_LEVEL_INF);

/* The value in RAM. settings_load() fills it in from flash; settings_save_one() writes it back. */
static uint32_t boot_count;

/*
 * Called by settings_load() once for every stored setting whose name starts with "boot/", with
 * name set to the rest of it. The value is not passed in: the handler reads it with read_cb, into
 * storage of its own, because only the handler knows how big it should be.
 */
static int boot_set(const char *name, size_t len, settings_read_cb read_cb, void *cb_arg)
{
	const char *next;

	if (settings_name_steq(name, "count", &next) && (next == NULL)) {
		if (len != sizeof(boot_count)) {
			return -EINVAL;
		}
		ssize_t read = read_cb(cb_arg, &boot_count, sizeof(boot_count));

		return (read < 0) ? (int)read : 0;
	}
	return -ENOENT;
}

/* Register the handler for the "boot" subtree at compile time, in a table the subsystem walks. */
SETTINGS_STATIC_HANDLER_DEFINE(boot, "boot", NULL, boot_set, NULL, NULL);

int main(void)
{
	int rc = settings_subsys_init();

	if (rc != 0) {
		LOG_ERR("settings_subsys_init() failed: %d", rc);
		return 0;
	}

	/* On the very first boot there is nothing stored, boot_set() is never called, and 0 stays.
	 */
	rc = settings_load();
	if (rc != 0) {
		LOG_ERR("settings_load() failed: %d", rc);
		return 0;
	}

	boot_count++;

	rc = settings_save_one("boot/count", &boot_count, sizeof(boot_count));
	if (rc != 0) {
		LOG_ERR("settings_save_one() failed: %d", rc);
		return 0;
	}

	LOG_INF("Boot count: %u", boot_count);
	return 0;
}
```
