## CMakeLists.txt
```
# SPDX-License-Identifier: MIT

cmake_minimum_required(VERSION 3.20.0)
find_package(Zephyr REQUIRED HINTS $ENV{ZEPHYR_BASE})
project(debugging)

target_sources(app PRIVATE src/main.c src/fatal.c)
```

## Kconfig
```
# SPDX-License-Identifier: MIT

menu "Application"

choice APP_BUG
	prompt "Bug to run into"
	default APP_BUG_NONE
	help
	  Every bug is a single wrong value passed to otherwise correct code, so the program with
	  and without it differs in one place only.

config APP_BUG_NONE
	bool "None: run the correct code only"

config APP_BUG_STACK_OVERFLOW
	bool "Write one byte past the end of an array on the stack (for CONFIG_ASAN)"

config APP_BUG_USE_AFTER_FREE
	bool "Read heap memory after freeing it (for CONFIG_ASAN)"

config APP_BUG_SIGNED_OVERFLOW
	bool "Overflow a signed integer (for CONFIG_UBSAN)"

config APP_BUG_OOPS
	bool "Call k_oops() in a thread (for the fatal error handler)"

config APP_BUG_ASSERT
	bool "Break an __ASSERT() (for CONFIG_ASSERT)"

endchoice

endmenu

source "Kconfig.zephyr"
```

## sample.yaml
```
sample:
  name: Debugging
  description: Correct code and five ways to call it wrongly, caught by sanitizers and the kernel.
common:
  platform_allow: native_sim/native/64
  integration_platforms:
    - native_sim/native/64
  extra_configs:
    - CONFIG_NATIVE_SIM_SLOWDOWN_TO_REAL_TIME=n
tests:
  qacademy.l06.debugging:
    harness: console
    harness_config:
      type: multi_line
      ordered: true
      regex:
        - "<inf> app: Filled 8 bytes"
        - "<inf> app: 5 mV is 5000000 nV"
        - "<inf> app: The configuration is valid"
        - "<inf> app: Battery at 42 %"
        - "<inf> app: main\\(\\) is still running, and returns"
  # An oops aborts one thread, and the program carries on and exits normally, so it can be checked.
  qacademy.l06.debugging.oops:
    extra_args:
      - EXTRA_CONF_FILE=oops.conf
    harness: console
    harness_config:
      type: multi_line
      ordered: true
      regex:
        - "ZEPHYR FATAL ERROR 3: Kernel oops on CPU 0"
        - "<err> fatal: Caught fatal error 3 in thread 'checker'"
        - "<inf> app: main\\(\\) is still running, and returns"
  # The others are only built. AddressSanitizer and a failed assertion end the program with exit
  # status 1, which Twister counts as a failure whatever was printed, and UndefinedBehaviorSanitizer
  # reports on stderr, which Twister's console harness does not read.
  qacademy.l06.debugging.asan:
    build_only: true
    extra_args:
      - EXTRA_CONF_FILE=asan.conf
  qacademy.l06.debugging.ubsan:
    build_only: true
    extra_args:
      - EXTRA_CONF_FILE=ubsan.conf
  qacademy.l06.debugging.assert:
    build_only: true
    extra_args:
      - EXTRA_CONF_FILE=assert.conf
```

## prj.conf
```kconfig
# Compile with -Og, so that GDB shows the variables and lines of the source as written.
CONFIG_DEBUG_OPTIMIZATIONS=y

# Name threads, so that fatal errors and GDB say which thread it was.
CONFIG_THREAD_NAME=y

CONFIG_LOG=y
```

## asan.conf
```kconfig
# AddressSanitizer, and the stack buffer overflow it catches:
#
#   west build -p -b native_sim/native/64 lectures/L06/examples/debugging -- -DEXTRA_CONF_FILE=asan.conf
#
# Add -DCONFIG_APP_BUG_USE_AFTER_FREE=y to run into the use after free instead.
CONFIG_ASAN=y
CONFIG_APP_BUG_STACK_OVERFLOW=y
```

## assert.conf
```kconfig
# Assertions, which are compiled out unless CONFIG_ASSERT=y, and the one that fails:
#
#   west build -p -b native_sim/native/64 lectures/L06/examples/debugging -- -DEXTRA_CONF_FILE=assert.conf
CONFIG_ASSERT=y
CONFIG_APP_BUG_ASSERT=y
```

## oops.conf
```kconfig
# A thread that calls k_oops(), caught by the application's fatal error handler:
#
#   west build -p -b native_sim/native/64 lectures/L06/examples/debugging -- -DEXTRA_CONF_FILE=oops.conf
CONFIG_APP_BUG_OOPS=y
```

## ubsan.conf
```kconfig
# UndefinedBehaviorSanitizer, and the signed integer overflow it catches:
#
#   west build -p -b native_sim/native/64 lectures/L06/examples/debugging -- -DEXTRA_CONF_FILE=ubsan.conf
CONFIG_UBSAN=y
CONFIG_APP_BUG_SIGNED_OVERFLOW=y
```

## src/main.c
```c
/*
 * SPDX-License-Identifier: MIT
 *
 * Correct code, and five ways to call it wrongly, for the sanitizers and the kernel to catch.
 */

#include <stdlib.h>
#include <string.h>

#include <zephyr/kernel.h>
#include <zephyr/logging/log.h>

LOG_MODULE_REGISTER(app, LOG_LEVEL_INF);

#define CHECKER_STACK_SIZE 1024
#define CHECKER_PRIORITY   5

/*
 * The functions are __noinline so that the compiler cannot see the wrong values at compile time.
 * It would warn about some of them, which is good in real code, but here the point is what
 * happens at run time.
 */

/* Fill a buffer with a pattern. Correct: it writes exactly size bytes. */
static __noinline void fill(char *buf, size_t size)
{
	for (size_t i = 0; i < size; i++) {
		buf[i] = (char)('a' + i);
	}
}

/* Convert millivolts to nanovolts. Correct, as long as the result fits in an int32_t. */
static __noinline int32_t millivolts_to_nanovolts(int32_t millivolts)
{
	return millivolts * 1000000;
}

/* Check a battery reading. The caller promises a percentage, and the assertion holds it to that. */
static __noinline void report_battery(int percent)
{
	__ASSERT(percent <= 100, "a battery cannot be %d %% full", percent);
	LOG_INF("Battery at %d %%", percent);
}

static void stack_example(void)
{
	char buf[8];

	/* The bug: an off-by-one in the size, one byte past the end of buf. */
	size_t size = IS_ENABLED(CONFIG_APP_BUG_STACK_OVERFLOW) ? sizeof(buf) + 1 : sizeof(buf);

	fill(buf, size);
	LOG_INF("Filled %zu bytes", size);
}

static void heap_example(void)
{
	char *name = malloc(16);

	if (name == NULL) {
		return;
	}
	strcpy(name, "sensor");

	/* The bug: freeing the name before its last use rather than after. */
	if (IS_ENABLED(CONFIG_APP_BUG_USE_AFTER_FREE)) {
		free(name);
	}
	LOG_INF("Name starts with '%c'", name[0]);
	if (!IS_ENABLED(CONFIG_APP_BUG_USE_AFTER_FREE)) {
		free(name);
	}
}

static void arithmetic_example(void)
{
	/* The bug: volts where millivolts were expected, 5000 mV is 5 000 000 000 nV. */
	int32_t millivolts = IS_ENABLED(CONFIG_APP_BUG_SIGNED_OVERFLOW) ? 5000 : 5;

	LOG_INF("%d mV is %d nV", millivolts, millivolts_to_nanovolts(millivolts));
}

static void checker(void *p1, void *p2, void *p3)
{
	ARG_UNUSED(p1);
	ARG_UNUSED(p2);
	ARG_UNUSED(p3);

	/* The bug: a check that finds the configuration broken, and gives up on the thread. */
	if (IS_ENABLED(CONFIG_APP_BUG_OOPS)) {
		LOG_ERR("The configuration is broken");
		k_oops();
	}
	LOG_INF("The configuration is valid");
}

K_THREAD_STACK_DEFINE(checker_stack, CHECKER_STACK_SIZE);
static struct k_thread checker_thread;

static void thread_example(void)
{
	k_thread_create(&checker_thread, checker_stack, CHECKER_STACK_SIZE, checker, NULL, NULL,
			NULL, CHECKER_PRIORITY, 0, K_NO_WAIT);
	k_thread_name_set(&checker_thread, "checker");

	/* An aborted thread counts as finished, so this returns after an oops too. */
	k_thread_join(&checker_thread, K_FOREVER);
}

static void assert_example(void)
{
	/* The bug: a value in tenths of a percent passed where a percentage was expected. */
	report_battery(IS_ENABLED(CONFIG_APP_BUG_ASSERT) ? 420 : 42);
}

int main(void)
{
	stack_example();
	heap_example();
	arithmetic_example();
	thread_example();
	assert_example();

	LOG_INF("main() is still running, and returns");
	return 0;
}
```

## src/fatal.c
```c
/*
 * SPDX-License-Identifier: MIT
 *
 * The application's fatal error handler, which decides what a fatal error costs.
 */

#include <zephyr/fatal.h>
#include <zephyr/kernel.h>
#include <zephyr/logging/log.h>
#include <zephyr/logging/log_ctrl.h>

LOG_MODULE_REGISTER(fatal, LOG_LEVEL_INF);

/*
 * Zephyr calls this after it has printed what went wrong, for every fatal error: an oops, a panic,
 * a failed assertion, a CPU exception on a board. The kernel's own version, a weak function, halts
 * the system. Defining one replaces it. If it returns, the kernel aborts only the thread that
 * caused the error, and the rest of the system keeps running.
 */
void k_sys_fatal_error_handler(unsigned int reason, const struct arch_esf *esf)
{
	ARG_UNUSED(esf);

	/* On a board, logging is deferred to a thread that may never run again: print now. */
	LOG_PANIC();

	LOG_ERR("Caught fatal error %u in thread '%s'", reason, k_thread_name_get(k_current_get()));

	if (reason == K_ERR_KERNEL_OOPS) {
		LOG_ERR("An oops: aborting only that thread");
		return;
	}

	/* A panic means the kernel itself cannot go on. Returning from one is not allowed. */
	LOG_ERR("Halting the system");
	k_fatal_halt(reason);
}
```
