## CMakeLists.txt
```
# SPDX-License-Identifier: MIT

cmake_minimum_required(VERSION 3.20.0)
find_package(Zephyr REQUIRED HINTS $ENV{ZEPHYR_BASE})
project(priority_inversion)

target_sources(app PRIVATE src/main.c)
```

## Kconfig
```
# SPDX-License-Identifier: MIT
#
# The application's own option: which primitive protects the shared resource.

menu "Application"

config APP_USE_MUTEX
	bool "Protect the resource with a k_mutex instead of a k_sem"
	help
	  A k_mutex raises the priority of the thread that holds it to that of the highest-priority
	  thread waiting for it (priority inheritance). A k_sem used as a lock does not.

endmenu

source "Kconfig.zephyr"
```

## sample.yaml
```
sample:
  name: Priority inversion
  description: Priority inversion with a semaphore, and priority inheritance with a mutex.
common:
  platform_allow: native_sim/native/64
  integration_platforms:
    - native_sim/native/64
  extra_configs:
    - CONFIG_NATIVE_SIM_SLOWDOWN_TO_REAL_TIME=n
  harness: console
tests:
  qacademy.l04.priority_inversion:
    harness_config:
      type: multi_line
      ordered: true
      regex:
        - "high   \\(priority 5\\) wants the semaphore"
        - "medium \\(priority 6\\) starts computing, needs no lock"
        - "medium \\(priority 6\\) is done"
        - "low    \\(priority 7\\) gives the semaphore back"
        - "high   \\(priority 5\\) has the semaphore"
  qacademy.l04.priority_inversion.mutex:
    extra_args:
      - EXTRA_CONF_FILE=mutex.conf
    harness_config:
      type: multi_line
      ordered: true
      regex:
        - "high   \\(priority 5\\) wants the mutex"
        - "low    \\(priority 5\\) gives the mutex back"
        - "high   \\(priority 5\\) has the mutex"
        - "medium \\(priority 6\\) starts computing, needs no lock"
```

## prj.conf
```kconfig
# One tick per millisecond instead of native_sim's default ten, so the trace shows the timing of the
# threads rather than the rounding of their sleeps to 10 ms ticks.
CONFIG_SYS_CLOCK_TICKS_PER_SEC=1000
```

## mutex.conf
```kconfig
# An extra configuration file, merged on top of prj.conf:
#
#   west build -p -b native_sim/native/64 lectures/L04/examples/priority_inversion -- \
#       -DEXTRA_CONF_FILE=mutex.conf
CONFIG_APP_USE_MUTEX=y
```

## src/main.c
```c
/*
 * SPDX-License-Identifier: MIT
 *
 * Priority inversion, produced with a semaphore and fixed with a mutex.
 */

#include <zephyr/kernel.h>

/* Lower numbers are higher priorities. All three threads are preemptible. */
#define HIGH_PRIORITY   5
#define MEDIUM_PRIORITY 6
#define LOW_PRIORITY    7

/* How long each thread computes, in milliseconds of CPU time. */
#define LOW_WORK_MS    100
#define MEDIUM_WORK_MS 500

#ifdef CONFIG_APP_USE_MUTEX
K_MUTEX_DEFINE(lock);
#define LOCK_NAME   "mutex"
#define lock_take() k_mutex_lock(&lock, K_FOREVER)
#define lock_give() k_mutex_unlock(&lock)
#else
/* A binary semaphore, initially available, used as a lock. It has no owner, so no inheritance. */
K_SEM_DEFINE(lock, 1, 1);
#define LOCK_NAME   "semaphore"
#define lock_take() k_sem_take(&lock, K_FOREVER)
#define lock_give() k_sem_give(&lock)
#endif

static void trace(const char *thread, const char *what)
{
	printk("[%4lld ms] %-6s (priority %d) %s\n", k_uptime_get(), thread,
	       k_thread_priority_get(k_current_get()), what);
}

/*
 * Stand in for computation that takes CPU time. On native_sim code runs in zero simulated time, so
 * a loop of instructions would take no time at all. k_busy_wait() advances the clock without
 * giving up the CPU, and it lets interrupts in, so a thread woken meanwhile can preempt this one.
 * One millisecond at a time, so that work interrupted by a preemption is not counted as done.
 */
static void compute(int ms)
{
	for (int i = 0; i < ms; i++) {
		k_busy_wait(USEC_PER_MSEC);
	}
}

static void low_thread(void)
{
	trace("low", "takes the " LOCK_NAME);
	lock_take();
	compute(LOW_WORK_MS);
	trace("low", "gives the " LOCK_NAME " back");
	lock_give();
	trace("low", "is done");
}

static void medium_thread(void)
{
	trace("medium", "starts computing, needs no lock");
	compute(MEDIUM_WORK_MS);
	trace("medium", "is done");
}

static void high_thread(void)
{
	int64_t start = k_uptime_get();

	trace("high", "wants the " LOCK_NAME);
	lock_take();
	trace("high", "has the " LOCK_NAME);
	printk("high waited %lld ms for the %s\n", k_uptime_get() - start, LOCK_NAME);
	lock_give();
}

/*
 * The start delays set up the scenario: low runs first and takes the lock, high arrives 20 ms
 * later and blocks on it, and medium arrives 10 ms after that, while low still holds the lock.
 */
K_THREAD_DEFINE(low, 1024, low_thread, NULL, NULL, NULL, LOW_PRIORITY, 0, 0);
K_THREAD_DEFINE(high, 1024, high_thread, NULL, NULL, NULL, HIGH_PRIORITY, 0, 20);
K_THREAD_DEFINE(medium, 1024, medium_thread, NULL, NULL, NULL, MEDIUM_PRIORITY, 0, 30);
```
