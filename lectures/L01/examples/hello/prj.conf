## CMakeLists.txt
```
# SPDX-License-Identifier: MIT

# Every Zephyr application starts with these three lines. find_package(Zephyr) is where the build
# system takes over: it reads the board, runs Kconfig and devicetree, and creates the `app` target
# that your sources are added to.
cmake_minimum_required(VERSION 3.20.0)
find_package(Zephyr REQUIRED HINTS $ENV{ZEPHYR_BASE})
project(hello)

target_sources(app PRIVATE src/main.c)
```

## sample.yaml
```
sample:
  name: Hello
  description: Printing, logging and sleeping on native_sim.
common:
  platform_allow: native_sim/native/64
  integration_platforms:
    - native_sim/native/64
  # Run as fast as the host allows rather than in real time; the output is the same either way.
  extra_configs:
    - CONFIG_NATIVE_SIM_SLOWDOWN_TO_REAL_TIME=n
tests:
  qacademy.l01.hello:
    harness: console
    harness_config:
      type: multi_line
      ordered: true
      regex:
        - "Hello from native_sim/native/64"
        - "<inf> hello: Tick 1 at 0 ms"
        - "<inf> hello: Tick 3 at 1020 ms"
        - "<wrn> hello: A warning, in yellow"
```

## prj.conf
```kconfig
# The application's Kconfig settings, applied on top of the board's defaults.
CONFIG_LOG=y
```

## src/main.c
```c
/*
 * SPDX-License-Identifier: MIT
 *
 * The smallest useful Zephyr program: print, log, sleep, and look at the clock.
 */

#include <zephyr/kernel.h>
#include <zephyr/logging/log.h>

/* Register this file as a log module named "hello", which logs at level INF and above. */
LOG_MODULE_REGISTER(hello, LOG_LEVEL_INF);

int main(void)
{
	/* printk() writes straight to the console, like printf() without the formatting library. */
	printk("Hello from %s\n", CONFIG_BOARD_TARGET);

	for (int i = 1; i <= 3; i++) {
		LOG_INF("Tick %d at %lld ms", i, k_uptime_get());
		k_sleep(K_MSEC(500));
	}

	LOG_WRN("A warning, in yellow");
	LOG_DBG("A debug message, filtered out at compile time by LOG_LEVEL_INF");

	/* Returning from main() ends the main thread, not the program: the kernel keeps running. */
	return 0;
}
```
