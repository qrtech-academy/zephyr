## CMakeLists.txt
```
# SPDX-License-Identifier: MIT

cmake_minimum_required(VERSION 3.20.0)
find_package(Zephyr REQUIRED HINTS $ENV{ZEPHYR_BASE})
project(kconfig)

target_sources(app PRIVATE src/main.c)

# Kconfig has run by now, so every option is a CMake variable too. This file is only compiled
# into the application when CONFIG_APP_SHOUT=y.
target_sources_ifdef(CONFIG_APP_SHOUT app PRIVATE src/shout.c)
```

## Kconfig
```
# SPDX-License-Identifier: MIT
#
# The application's own configuration options. An application that has a file named Kconfig
# replaces Zephyr's top-level Kconfig with it, so it must source Kconfig.zephyr at the end, or it
# would have no kernel options at all. The options below then appear in menuconfig and in .config
# exactly like Zephyr's own, and reach C as CONFIG_ macros and CMake as CONFIG_ variables.

menu "Application"

config APP_GREETING
	string "Greeting to print"
	default "Hello"

config APP_REPEAT
	int "How many times to print the greeting"
	range 1 10
	default 3

config APP_PERIOD_MS
	int "Delay between greetings, in milliseconds"
	range 10 10000
	default 1000

config APP_SHOUT
	bool "Print the greeting in capitals"
	help
	  Builds src/shout.c into the application and passes the greeting through it.

endmenu

source "Kconfig.zephyr"
```

## sample.yaml
```
sample:
  name: Kconfig
  description: An application configured through its own Kconfig options.
common:
  platform_allow: native_sim/native/64
  integration_platforms:
    - native_sim/native/64
  extra_configs:
    - CONFIG_NATIVE_SIM_SLOWDOWN_TO_REAL_TIME=n
  harness: console
tests:
  qacademy.l01.kconfig:
    harness_config:
      type: multi_line
      ordered: true
      regex:
        - "<inf> kconfig: Hej \\(1 of 3\\)"
        - "<inf> kconfig: Hej \\(3 of 3\\)"
  qacademy.l01.kconfig.shout:
    extra_args:
      - EXTRA_CONF_FILE=shout.conf
    harness_config:
      type: multi_line
      ordered: true
      regex:
        - "<inf> kconfig: HEJ \\(1 of 2\\)"
        - "<inf> kconfig: HEJ \\(2 of 2\\)"
```

## prj.conf
```kconfig
# The application's settings. Anything not set here keeps its default from Kconfig.
CONFIG_LOG=y
CONFIG_APP_GREETING="Hej"
CONFIG_APP_PERIOD_MS=250
```

## shout.conf
```kconfig
# An extra configuration file, merged on top of prj.conf:
#
#   west build -b native_sim/native/64 lectures/L01/examples/kconfig -- -DEXTRA_CONF_FILE=shout.conf
CONFIG_APP_SHOUT=y
CONFIG_APP_REPEAT=2
```

## src/main.c
```c
/*
 * SPDX-License-Identifier: MIT
 *
 * An application configured through its own Kconfig options.
 */

#include <zephyr/kernel.h>
#include <zephyr/logging/log.h>

#include "shout.h"

LOG_MODULE_REGISTER(kconfig, LOG_LEVEL_INF);

int main(void)
{
	const char *greeting = CONFIG_APP_GREETING;
	char loud[32];

	/*
	 * IS_ENABLED() is 1 or 0, so both branches are compiled and type-checked in every
	 * configuration, and the compiler removes the one that cannot run. shout() is only linked
	 * in when CONFIG_APP_SHOUT=y, which is fine: in any other configuration no call to it
	 * remains.
	 */
	if (IS_ENABLED(CONFIG_APP_SHOUT)) {
		shout(greeting, loud, sizeof(loud));
		greeting = loud;
	}

	for (int i = 1; i <= CONFIG_APP_REPEAT; i++) {
		LOG_INF("%s (%d of %d)", greeting, i, CONFIG_APP_REPEAT);
		k_msleep(CONFIG_APP_PERIOD_MS);
	}

	return 0;
}
```

## src/shout.c
```c
/*
 * SPDX-License-Identifier: MIT
 */

#include <ctype.h>

#include "shout.h"

void shout(const char *in, char *out, size_t size)
{
	size_t i = 0;

	for (; (i + 1 < size) && (in[i] != '\0'); i++) {
		out[i] = (char)toupper((unsigned char)in[i]);
	}
	out[i] = '\0';
}
```

## src/shout.h
```c
/*
 * SPDX-License-Identifier: MIT
 */

#ifndef SHOUT_H_
#define SHOUT_H_

#include <stddef.h>

/**
 * @brief Copy a string into a buffer in capitals.
 *
 * @param in   The string to copy.
 * @param out  The buffer to copy it into. Always NUL-terminated.
 * @param size The size of the buffer.
 */
void shout(const char *in, char *out, size_t size);

#endif /* SHOUT_H_ */
```
