## CMakeLists.txt
```
# SPDX-License-Identifier: MIT

cmake_minimum_required(VERSION 3.20.0)
find_package(Zephyr REQUIRED HINTS $ENV{ZEPHYR_BASE})
project(busy_loop)

target_sources(app PRIVATE src/main.c)
```

## Kconfig
```
# SPDX-License-Identifier: MIT

menu "Application"

config APP_BUSY_LOOP
	bool "Wait for the timer in a busy loop"
	help
	  Makes main() wait for the timer by spinning on a flag, instead of blocking on a semaphore.
	  On a microcontroller that works, wastefully. On native_sim it never finishes, because
	  no simulated time passes while a thread runs, so the timer never expires.

endmenu

source "Kconfig.zephyr"
```

## sample.yaml
```
sample:
  name: Busy loop
  description: Waiting for a timer interrupt by blocking, and by spinning, which stalls native_sim.
common:
  platform_allow: native_sim/native/64
  integration_platforms:
    - native_sim/native/64
  extra_configs:
    - CONFIG_NATIVE_SIM_SLOWDOWN_TO_REAL_TIME=n
tests:
  qacademy.l03.busy_loop:
    harness: console
    harness_config:
      type: multi_line
      ordered: true
      regex:
        - "0 ms: timer started, waiting for it to expire"
        - "blocking on a semaphore"
        - "500 ms: timer expired"
  # The busy-loop variant never finishes on native_sim, so it is only built, never run.
  qacademy.l03.busy_loop.spinning:
    build_only: true
    extra_args:
      - EXTRA_CONF_FILE=busy.conf
```

## prj.conf
```kconfig
# Nothing to set: the application's one option, CONFIG_APP_BUSY_LOOP, is off unless busy.conf is
# merged in:
#
#   west build -b native_sim/native/64 lectures/L03/examples/busy_loop -- -DEXTRA_CONF_FILE=busy.conf
```

## busy.conf
```kconfig
# Wait for the timer in a busy loop. On native_sim, the program stalls.
CONFIG_APP_BUSY_LOOP=y
```

## src/main.c
```c
/*
 * SPDX-License-Identifier: MIT
 *
 * Waiting for an interrupt: by blocking, and by spinning, which stalls native_sim.
 */

#include <stdbool.h>

#include <zephyr/kernel.h>

/* Set by the timer's expiry function, in interrupt context. */
static volatile bool expired;
static K_SEM_DEFINE(expired_sem, 0, 1);

static void timer_expired(struct k_timer *timer)
{
	expired = true;
	k_sem_give(&expired_sem);
}

static K_TIMER_DEFINE(timer, timer_expired, NULL);

int main(void)
{
	k_timer_start(&timer, K_MSEC(500), K_NO_WAIT);
	printk("%lld ms: timer started, waiting for it to expire\n", k_uptime_get());

	if (IS_ENABLED(CONFIG_APP_BUSY_LOOP)) {
		/*
		 * On a microcontroller, the timer interrupt preempts this loop after 500 ms of
		 * spinning, sets the flag, and the loop ends. On native_sim, the loop runs in zero
		 * simulated time: time only moves on when the CPU goes idle, and a thread spinning
		 * here never lets it. The timer never expires, and nothing else ever runs again.
		 */
		printk("spinning until the flag is set\n");
		while (!expired) {
		}
	} else {
		/*
		 * Blocking lets the CPU go idle, time passes, the timer interrupt arrives, and the
		 * semaphore wakes this thread. It is also what a microcontroller should do, because
		 * a spinning CPU burns power for nothing.
		 */
		printk("blocking on a semaphore\n");
		k_sem_take(&expired_sem, K_FOREVER);
	}

	printk("%lld ms: timer expired\n", k_uptime_get());
	return 0;
}
```
