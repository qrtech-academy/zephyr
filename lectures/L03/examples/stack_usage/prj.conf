## CMakeLists.txt
```
# SPDX-License-Identifier: MIT

cmake_minimum_required(VERSION 3.20.0)
find_package(Zephyr REQUIRED HINTS $ENV{ZEPHYR_BASE})
project(stack_usage)

target_sources(app PRIVATE src/main.c)
```

## sample.yaml
```
sample:
  name: Stack usage
  description: Static per-function stack analysis with -fstack-usage, where runtime checks are unavailable.
common:
  platform_allow: native_sim/native/64
  integration_platforms:
    - native_sim/native/64
  extra_configs:
    - CONFIG_NATIVE_SIM_SLOWDOWN_TO_REAL_TIME=n
tests:
  qacademy.l03.stack_usage:
    harness: console
    harness_config:
      type: multi_line
      ordered: true
      regex:
        - "round 1: report of 2048 bytes, on a stack of 1024 bytes"
        - "round 3: report of 2048 bytes, on a stack of 1024 bytes"
```

## prj.conf
```kconfig
# Compile everything with -fstack-usage: next to every object file, the compiler writes a .su file
# with the stack each function in it needs, excluding what the functions it calls need.
CONFIG_STACK_USAGE=y
```

## src/main.c
```c
/*
 * SPDX-License-Identifier: MIT
 *
 * A thread whose stack is too small, which native_sim cannot notice and -fstack-usage can.
 */

#include <stdio.h>

#include <zephyr/kernel.h>

/* The stack size given to the reporter thread. */
#define REPORTER_STACK_SIZE 1024

/*
 * Formats a report into a local buffer. The buffer alone is twice the size of the stack of the
 * thread that calls this function.
 */
static void print_report(int round)
{
	char report[2048];

	snprintf(report, sizeof(report), "round %d: report of %zu bytes, on a stack of %d bytes",
		 round, sizeof(report), REPORTER_STACK_SIZE);
	printk("%s\n", report);
}

static void reporter_entry(void *p1, void *p2, void *p3)
{
	for (int round = 1; round <= 3; round++) {
		print_report(round);
		k_msleep(100);
	}
}

/*
 * On a microcontroller, print_report() would write far past the end of this thread's stack, into
 * whatever lies below it. On native_sim the program runs fine: the thread really runs on a host
 * thread's stack, megabytes deep, and the 1024 bytes reserved here are hardly used.
 */
K_THREAD_DEFINE(reporter, REPORTER_STACK_SIZE, reporter_entry, NULL, NULL, NULL, 5, 0, 0);

int main(void)
{
	return 0;
}
```
